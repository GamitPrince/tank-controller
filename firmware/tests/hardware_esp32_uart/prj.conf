## CMakeLists.txt
```
# ztest application for the FRDM-to-ESP32 UART driver glue (S-048), built by
# Twister on native_sim with Zephyr's emulated UART. The end-to-end test
# reuses the outage buffer tests' scan generator and 10 MB simulated flash.
cmake_minimum_required(VERSION 3.20.0)

set(FLASH_LOG_TEST_DIR ${CMAKE_CURRENT_SOURCE_DIR}/../record_flash_log)
set(DTC_OVERLAY_FILE "${FLASH_LOG_TEST_DIR}/app.overlay;${CMAKE_CURRENT_SOURCE_DIR}/uart.overlay")

find_package(Zephyr REQUIRED HINTS $ENV{ZEPHYR_BASE})
project(hardware_esp32_uart)

set(SRC_DIR ${CMAKE_CURRENT_SOURCE_DIR}/../../src)
# The shared link library (S-056, ADR-0003 amendment 1), also built for the ESP32.
set(LINK_DIR ${CMAKE_CURRENT_SOURCE_DIR}/../../../shared/link-protocol)

target_sources(app PRIVATE
  src/main.c
  src/end_to_end.c
  ${FLASH_LOG_TEST_DIR}/src/scan_gen.c
  ${SRC_DIR}/hardware/esp32_uart.c
  ${SRC_DIR}/record/scan_codec.c
  ${SRC_DIR}/record/flash_log.c
  ${SRC_DIR}/record/record_cbor.c
  ${LINK_DIR}/link_frame.c
  ${LINK_DIR}/link_receiver.c
  ${LINK_DIR}/link_sender.c
  ${SRC_DIR}/communications/log_forwarder.c
  ${SRC_DIR}/communications/uplink.c
)

target_include_directories(app PRIVATE
  ${FLASH_LOG_TEST_DIR}/src
  ${SRC_DIR}/hardware
  ${SRC_DIR}/record
  ${SRC_DIR}/measurement
  ${SRC_DIR}/communications
  ${LINK_DIR}
)
```

## prj.conf
```kconfig
CONFIG_ZTEST=y
# Frame buffers, decoders and the CBOR record buffer are each ~1 KB.
CONFIG_ZTEST_STACK_SIZE=16384
CONFIG_FLASH=y
CONFIG_CRC=y
CONFIG_SERIAL=y
CONFIG_UART_INTERRUPT_DRIVEN=y
CONFIG_EMUL=y
```

## uart.overlay
```dts
/*
 * An emulated UART standing in for the FRDM's UART to the ESP32 (S-048).
 * The FIFOs are large enough for a whole record frame.
 */
/ {
	chosen {
		tank,esp32-uart = &esp32_uart;
	};

	esp32_uart: esp32-uart {
		compatible = "zephyr,uart-emul";
		status = "okay";
		current-speed = <115200>;
		rx-fifo-size = <1024>;
		tx-fifo-size = <2048>;
	};
};
```

## src/main.c
```c
/*
 * ztest suite for the FRDM-to-ESP32 UART driver glue (S-048), on Zephyr's
 * emulated UART: frames arriving in pieces, read timeouts, garbage and
 * overflow recovery, and exact bytes on the wire. The end-to-end path is in
 * end_to_end.c.
 */

#include <errno.h>
#include <string.h>

#include <zephyr/drivers/serial/uart_emul.h>
#include <zephyr/ztest.h>

#include "esp32_uart.h"
#include "link_frame.h"

#define UART_NODE DT_CHOSEN(tank_esp32_uart)
#define READ_TIMEOUT_MS 1000U
#define SHORT_TIMEOUT_MS 100U
#define TIMING_SLACK_MS 50U
#define LATE_PART_MS 20U
#define SETTLE_MS 10U
#define EMUL_CHUNK 256U
#define OVERFLOW_CHUNKS 3U
#define SEQ 0x1234U
#define CRC_FLIP 0x40U

static const struct device *const dev = DEVICE_DT_GET(UART_NODE);
static struct tank_esp32_uart uart;
static uint8_t frame[TANK_LINK_FRAME_MAX];
static size_t frame_len;
static size_t late_from;

/* A DELIVERED frame for SEQ, the kind the ESP32 sends. */
static void build_delivered(void)
{
	const uint8_t payload[TANK_LINK_DELIVERED_PAYLOAD_LEN] = {SEQ & 0xFFU, SEQ >> 8};
	const struct tank_link_msg msg = {
	    .type = TANK_LINK_DELIVERED, .payload = payload, .payload_len = sizeof(payload)};

	zassert_ok(tank_link_frame_encode(&msg, frame, sizeof(frame), &frame_len));
}

static void expect_delivered(const struct tank_link_msg *msg)
{
	zassert_equal(msg->type, TANK_LINK_DELIVERED);
	zassert_equal(msg->payload_len, TANK_LINK_DELIVERED_PAYLOAD_LEN);
	zassert_equal(msg->payload[0] | (msg->payload[1] << 8), SEQ);
}

static void put(const uint8_t *bytes, size_t len)
{
	zassert_equal(uart_emul_put_rx_data(dev, bytes, len), len);
}

static void send_late_part(struct k_timer *timer)
{
	ARG_UNUSED(timer);
	uart_emul_put_rx_data(dev, &frame[late_from], frame_len - late_from);
}

K_TIMER_DEFINE(late_timer, send_late_part, NULL);

static void before_each(void *fixture)
{
	ARG_UNUSED(fixture);
	uart_emul_callback_tx_data_ready_set(dev, NULL, NULL);
	uart_emul_flush_rx_data(dev);
	uart_emul_flush_tx_data(dev);
	zassert_ok(tank_esp32_uart_init(&uart, dev));
	build_delivered();
}

ZTEST_SUITE(esp32_uart, NULL, NULL, before_each, NULL, NULL);

ZTEST(esp32_uart, test_frame_in_pieces_is_returned_once_complete)
{
	struct tank_link_msg msg;

	late_from = frame_len / 2U;
	put(frame, late_from);
	zassert_equal(tank_esp32_uart_read(&uart, &msg, SETTLE_MS), -EAGAIN, "only half arrived");
	k_timer_start(&late_timer, K_MSEC(LATE_PART_MS), K_NO_WAIT);
	zassert_ok(tank_esp32_uart_read(&uart, &msg, READ_TIMEOUT_MS));
	expect_delivered(&msg);
	zassert_equal(tank_esp32_uart_stats(&uart)->frames, 1U);
	zassert_equal(tank_esp32_uart_stats(&uart)->rx_bytes, frame_len);
}

ZTEST(esp32_uart, test_read_times_out_after_its_timeout)
{
	struct tank_link_msg msg;
	int64_t start = k_uptime_get();
	int64_t took;

	zassert_equal(tank_esp32_uart_read(&uart, &msg, SHORT_TIMEOUT_MS), -EAGAIN);
	took = k_uptime_get() - start;
	zassert_true(took >= SHORT_TIMEOUT_MS, "returned after %lld ms", took);
	zassert_true(took < SHORT_TIMEOUT_MS + TIMING_SLACK_MS, "returned after %lld ms", took);
}

ZTEST(esp32_uart, test_garbage_and_a_bad_frame_are_skipped)
{
	static const uint8_t garbage[] = {0x11U, 0x22U, 0x00U};
	uint8_t bad[TANK_LINK_FRAME_MAX];
	struct tank_link_msg msg;

	memcpy(bad, frame, frame_len);
	bad[frame_len - 2U] ^= CRC_FLIP;
	put(garbage, sizeof(garbage));
	put(bad, frame_len);
	put(frame, frame_len);
	zassert_ok(tank_esp32_uart_read(&uart, &msg, READ_TIMEOUT_MS));
	expect_delivered(&msg);
	zassert_equal(tank_esp32_uart_stats(&uart)->rejected, 2U);
}

ZTEST(esp32_uart, test_overflow_is_counted_and_the_next_frame_arrives)
{
	static const uint8_t delimiter = 0x00U;
	uint8_t noise[EMUL_CHUNK];
	struct tank_link_msg msg;

	memset(noise, 0x55, sizeof(noise));
	for (uint32_t i = 0U; i < OVERFLOW_CHUNKS; i++) {
		put(noise, sizeof(noise));
		k_msleep(SETTLE_MS);
	}
	zassert_equal(tank_esp32_uart_stats(&uart)->rx_dropped,
		      OVERFLOW_CHUNKS * EMUL_CHUNK - TANK_ESP32_UART_RX_RING);
	zassert_equal(tank_esp32_uart_read(&uart, &msg, SETTLE_MS), -EAGAIN);
	put(&delimiter, 1U);
	put(frame, frame_len);
	zassert_ok(tank_esp32_uart_read(&uart, &msg, READ_TIMEOUT_MS));
	expect_delivered(&msg);
}

ZTEST(esp32_uart, test_write_puts_exactly_the_frame_on_the_wire)
{
	uint8_t wire[TANK_LINK_FRAME_MAX];

	zassert_ok(tank_esp32_uart_write(&uart, frame, frame_len));
	zassert_equal(uart_emul_get_tx_data(dev, wire, sizeof(wire)), frame_len);
	zassert_mem_equal(wire, frame, frame_len);
}

ZTEST(esp32_uart, test_clock_and_bad_arguments)
{
	struct tank_link_msg msg;
	uint32_t before = k_uptime_get_32();

	zassert_true(tank_esp32_uart_now(NULL) - before < TIMING_SLACK_MS);
	zassert_equal(tank_esp32_uart_init(NULL, dev), -EINVAL);
	zassert_equal(tank_esp32_uart_init(&uart, NULL), -EINVAL);
	zassert_equal(tank_esp32_uart_read(NULL, &msg, 0U), -EINVAL);
	zassert_equal(tank_esp32_uart_read(&uart, NULL, 0U), -EINVAL);
	zassert_equal(tank_esp32_uart_write(NULL, frame, 1U), -EINVAL);
	zassert_equal(tank_esp32_uart_write(&uart, NULL, 1U), -EINVAL);
	zassert_ok(tank_esp32_uart_write(&uart, NULL, 0U));
	zassert_is_null(tank_esp32_uart_stats(NULL));
}
```

## src/end_to_end.c
```c
/*
 * End to end on native_sim (S-048): a real flash log, log_forwarder (S-039),
 * the uplink (S-045) and the UART driver glue, talking over Zephyr's
 * emulated UART to an emulated ESP32 built from S-043's link_receiver. The
 * ESP32 side confirms each new record at once, as if the cloud had it, and
 * can lose a DELIVERED.
 */

#include <string.h>

#include <zephyr/drivers/serial/uart_emul.h>
#include <zephyr/ztest.h>

#include "esp32_uart.h"
#include "flash_log.h"
#include "link_frame.h"
#include "link_receiver.h"
#include "link_sender.h"
#include "log_forwarder.h"
#include "scan_gen.h"
#include "uplink.h"

#define UART_NODE DT_CHOSEN(tank_esp32_uart)
#define DEV_ID "tank-test-01"
#define RING_SECTORS 4U
#define BATCH_CAP 8U
#define BATCH_SCANS 5U
#define ACK_TIMEOUT_MS 200U
#define ATTEMPTS 3U
#define BOOT 0U

static const struct device *const dev = DEVICE_DT_GET(UART_NODE);
static struct tank_esp32_uart uart;
static struct tank_uplink up;
static struct tank_flash_log log;
static struct tank_log_item batch[BATCH_CAP];

/* The emulated ESP32. */
static struct {
	struct tank_link_decoder dec;
	struct tank_link_receiver rx;
	/* Frames passed up, and the records inside them (S-063). */
	uint32_t frames;
	uint32_t records;
	uint32_t drop_delivered;
} esp;

static const struct tank_log_forwarder fw = {
    .log = &log, .send_fn = tank_uplink_send, .ctx = &up, .batch = batch, .batch_cap = BATCH_CAP};

static void reply(uint16_t seq)
{
	uint8_t out[TANK_LINK_FRAME_MAX];
	size_t len;

	zassert_ok(tank_link_receiver_confirm(&esp.rx, seq, out, sizeof(out), &len));
	if (esp.drop_delivered > 0U) {
		esp.drop_delivered--;
		return;
	}
	zassert_equal(uart_emul_put_rx_data(dev, out, len), len);
}

static void on_frame(const struct tank_link_msg *msg)
{
	int action = tank_link_receiver_on_msg(&esp.rx, msg);

	if (action == TANK_LINK_RECV_DELIVER) {
		esp.frames++;
		/* A batch's CBOR array header holds its record count. */
		esp.records += msg->payload[0] & 0x1FU;
	}
	if (action != TANK_LINK_RECV_NONE) {
		reply(msg->seq);
	}
}

/* Bytes the FRDM wrote, one poll_out at a time. */
static void esp_hears(const struct device *d, size_t size, void *user_data)
{
	struct tank_link_msg msg;
	uint8_t byte;

	ARG_UNUSED(size);
	ARG_UNUSED(user_data);
	while (uart_emul_get_tx_data(d, &byte, 1U) == 1U) {
		if (tank_link_decoder_push(&esp.dec, byte, &msg) == TANK_LINK_RX_FRAME) {
			on_frame(&msg);
		}
	}
}

static void before_each(void *fixture)
{
	const struct tank_link_sender_config link_cfg = {.ack_timeout_ms = ACK_TIMEOUT_MS,
							 .max_attempts = ATTEMPTS};
	const struct tank_uplink_io io = {.write_fn = tank_esp32_uart_write,
					  .read_fn = tank_esp32_uart_read,
					  .now_fn = tank_esp32_uart_now,
					  .ctx = &uart};
	struct tank_flash_log_config cfg = scan_gen_log_config(RING_SECTORS);
	struct tank_scan s;

	ARG_UNUSED(fixture);
	memset(&esp, 0, sizeof(esp));
	tank_link_decoder_init(&esp.dec);
	tank_link_receiver_init(&esp.rx);
	uart_emul_flush_rx_data(dev);
	uart_emul_flush_tx_data(dev);
	uart_emul_callback_tx_data_ready_set(dev, esp_hears, NULL);
	zassert_ok(tank_esp32_uart_init(&uart, dev));
	zassert_ok(tank_uplink_init(&up, DEV_ID, &link_cfg, &io));

	scan_gen_erase();
	zassert_ok(tank_flash_log_mount(&log, &cfg));
	for (uint32_t seq = 1U; seq <= BATCH_SCANS; seq++) {
		scan_gen(&s, BOOT, seq, false);
		zassert_ok(tank_flash_log_append(&log, &s));
	}
}

static void after_each(void *fixture)
{
	ARG_UNUSED(fixture);
	uart_emul_callback_tx_data_ready_set(dev, NULL, NULL);
}

ZTEST_SUITE(esp32_uart_end_to_end, NULL, NULL, before_each, after_each, NULL);

ZTEST(esp32_uart_end_to_end, test_batch_is_confirmed_over_the_uart)
{
	zassert_equal(tank_log_forwarder_poll(&fw), BATCH_SCANS);
	zassert_equal(tank_log_forwarder_poll(&fw), 0, "the batch was acked");
	zassert_equal(esp.records, BATCH_SCANS);
	zassert_equal(esp.frames, 1U, "five records travel in one frame");
	zassert_equal(tank_uplink_stats(&up)->confirmed, 1U);
	zassert_equal(tank_link_sender_stats(&up.sender)->retransmitted, 0U);
	zassert_equal(tank_esp32_uart_stats(&uart)->frames, 1U, "one DELIVERED came back");
}

ZTEST(esp32_uart_end_to_end, test_lost_delivered_is_recovered_once)
{
	esp.drop_delivered = 1U;
	zassert_equal(tank_log_forwarder_poll(&fw), BATCH_SCANS);
	zassert_equal(esp.records, BATCH_SCANS, "each record passed up once");
	zassert_equal(esp.frames, 1U);
	zassert_equal(tank_link_receiver_stats(&esp.rx)->duplicates, 1U);
	zassert_equal(tank_link_sender_stats(&up.sender)->retransmitted, 1U);
}
```
