## CMakeLists.txt
```
# ztest application for the firmware application boot (S-060), built by
# Twister on native_sim's flash simulator with every signal-list table. It
# reuses the outage buffer tests' 10 MB simulated flash and the UART driver
# tests' emulated ESP32 UART.
cmake_minimum_required(VERSION 3.20.0)

set(FLASH_LOG_TEST_DIR ${CMAKE_CURRENT_SOURCE_DIR}/../record_flash_log)
set(DTC_OVERLAY_FILE
    "${FLASH_LOG_TEST_DIR}/app.overlay;${CMAKE_CURRENT_SOURCE_DIR}/../hardware_esp32_uart/uart.overlay")

find_package(Zephyr REQUIRED HINTS $ENV{ZEPHYR_BASE})
project(app_tank_app)

set(FIRMWARE_DIR ${CMAKE_CURRENT_SOURCE_DIR}/../..)
set(SRC_DIR ${FIRMWARE_DIR}/src)
include(${FIRMWARE_DIR}/cmake/tank_app_sources.cmake)

target_sources(app PRIVATE
  src/main.c
  src/uplink.c
  ${FLASH_LOG_TEST_DIR}/src/scan_gen.c
  # The emulated ESP32's side of the link; the application itself only sends.
  ${FIRMWARE_DIR}/../shared/link-protocol/link_receiver.c
)
target_include_directories(app PRIVATE ${FLASH_LOG_TEST_DIR}/src)
tank_add_app_sources(app ${CMAKE_CURRENT_BINARY_DIR}/generated)
```

## prj.conf
```kconfig
CONFIG_ZTEST=y
# Frame buffers, decoders and the record buffer are each about 1 KB.
CONFIG_ZTEST_STACK_SIZE=16384
CONFIG_FLASH=y
CONFIG_CRC=y
CONFIG_HWINFO=y
CONFIG_SERIAL=y
CONFIG_UART_INTERRUPT_DRIVEN=y
CONFIG_EMUL=y
```

## src/main.c
```c
/*
 * ztest suite for the application boot (S-060) on native_sim's flash
 * simulator: every Phase 1 input is set up from the signal-list tables in
 * scan order, scans start without any network, an unsampled input is never
 * given a value, and bad configuration is refused.
 */

#include <errno.h>

#include <zephyr/kernel.h>
#include <zephyr/ztest.h>

#include "scan_gen.h"
#include "tank_app.h"

#define RING_SECTORS 16U
#define PERIOD_MS 50U
#define RUN_MS 120U
#define AGREEMENT_MS 1000U
#define PHASE1_LEVELS 2U
#define PHASE1_TEMPERATURES 6U
#define PHASE1_CONTACTS 15U

static const uint16_t scan_order[] = {1001, 1002, 2001, 2002, 2003, 2004, 2005, 2006,
				      3001, 3002, 3011, 3012, 3013, 3014, 3015, 3016,
				      3021, 3022, 3023, 3024, 3025, 3026, 3027};

static uint8_t boot_id[TANK_BOOT_ID_LEN];
static struct tank_app app;
static struct tank_log_item item;

static struct tank_app_config config(void)
{
	return (struct tank_app_config){.boot_id = boot_id,
					.log = scan_gen_log_config(RING_SECTORS),
					.scan_period_ms = PERIOD_MS,
					.clock_agreement_limit_ms = AGREEMENT_MS};
}

static void before_each(void *fixture)
{
	ARG_UNUSED(fixture);
	scan_gen_erase();
	for (uint8_t i = 0U; i < TANK_BOOT_ID_LEN; i++) {
		boot_id[i] = (uint8_t)(0xA0U + i);
	}
}

static void after_each(void *fixture)
{
	ARG_UNUSED(fixture);
	(void)tank_app_stop(&app);
}

ZTEST_SUITE(app_tank_app, NULL, NULL, before_each, after_each, NULL);

ZTEST(app_tank_app, test_every_input_is_set_up_in_scan_order)
{
	const struct tank_app_config cfg = config();
	const struct tank_scan_sources *src;

	zassert_ok(tank_app_start(&app, &cfg));
	src = tank_app_sources(&app);
	zassert_equal(src->level_count, PHASE1_LEVELS);
	zassert_equal(src->temperature_count, PHASE1_TEMPERATURES);
	zassert_equal(src->contact_count, PHASE1_CONTACTS);
	zassert_equal(src->level_count + src->temperature_count + src->contact_count,
		      ARRAY_SIZE(scan_order));
}

ZTEST(app_tank_app, test_scans_start_with_no_network_and_carry_no_made_up_value)
{
	const struct tank_app_config cfg = config();
	uint32_t scans = 0U;

	zassert_ok(tank_app_start(&app, &cfg));
	k_msleep(RUN_MS);
	zassert_ok(tank_app_stop(&app));

	while (tank_flash_log_read_next(&app.log, &item) == 0) {
		zassert_equal(item.kind, TANK_LOG_ITEM_SCAN);
		zassert_mem_equal(item.scan.boot_id, boot_id, TANK_BOOT_ID_LEN);
		zassert_equal(item.scan.sl, 1U);
		zassert_false(item.scan.tk, "no clock sync yet");
		zassert_equal(item.scan.count, ARRAY_SIZE(scan_order));
		for (uint8_t i = 0U; i < item.scan.count; i++) {
			zassert_equal(item.scan.r[i].id, scan_order[i]);
			zassert_false(item.scan.r[i].has_val, "signal %u was never sampled",
				      item.scan.r[i].id);
		}
		scans++;
	}
	zassert_true(scans >= RUN_MS / PERIOD_MS, "only %u scans", scans);
}

ZTEST(app_tank_app, test_a_running_app_is_not_restarted)
{
	const struct tank_app_config cfg = config();

	zassert_ok(tank_app_start(&app, &cfg));
	zassert_equal(tank_app_start(&app, &cfg), -EALREADY);
	zassert_ok(tank_app_stop(&app));
	zassert_ok(tank_app_start(&app, &cfg), "a stopped app starts again");
}

ZTEST(app_tank_app, test_bad_configuration_is_refused)
{
	struct tank_app_config cfg = config();

	zassert_equal(tank_app_start(NULL, &cfg), -EINVAL);
	zassert_equal(tank_app_start(&app, NULL), -EINVAL);
	cfg.boot_id = NULL;
	zassert_equal(tank_app_start(&app, &cfg), -EINVAL);
	cfg = config();
	cfg.clock_agreement_limit_ms = 0U;
	zassert_equal(tank_app_start(&app, &cfg), -EINVAL, "boot time");
	cfg = config();
	cfg.log.size = 0U;
	zassert_equal(tank_app_start(&app, &cfg), -EINVAL, "flash log");
	cfg = config();
	cfg.scan_period_ms = 0U;
	zassert_equal(tank_app_start(&app, &cfg), -EINVAL, "scan service");
	zassert_equal(tank_app_stop(NULL), -EINVAL);
	zassert_is_null(tank_app_sources(NULL));
}
```

## src/uplink.c
```c
/*
 * The application's uplink (S-061) on native_sim: scans keep being logged
 * while nothing answers on the ESP32 UART, an emulated ESP32 that confirms
 * each record drains the log, and the device ID is the factory ID in hex.
 */

#include <errno.h>
#include <string.h>

#include <zephyr/drivers/serial/uart_emul.h>
#include <zephyr/ztest.h>

#include "device_id.h"
#include "link_frame.h"
#include "link_receiver.h"
#include "scan_gen.h"
#include "tank_app.h"

#define UART_NODE DT_CHOSEN(tank_esp32_uart)
#define RING_SECTORS 16U
#define PERIOD_MS 50U
#define RUN_MS 400U
#define IDLE_MS 20U
#define RETRY_MS 100U
/* Far longer than the test runs, so only a prompt send can deliver. */
#define LONG_IDLE_MS 10000U
#define SETTLE_MS 150U
#define AGREEMENT_MS 1000U
#define DEV_ID "0123456789abcdef0123456789abcdef"

static const struct device *const uart_dev = DEVICE_DT_GET(UART_NODE);
static uint8_t boot_id[TANK_BOOT_ID_LEN] = {1};
static struct tank_app app;

/* The emulated ESP32: confirms every new record at once. */
static struct {
	struct tank_link_decoder dec;
	struct tank_link_receiver rx;
	uint32_t records;
} esp;

static void esp_reply(uint16_t seq)
{
	uint8_t out[TANK_LINK_FRAME_MAX];
	size_t len;

	zassert_ok(tank_link_receiver_confirm(&esp.rx, seq, out, sizeof(out), &len));
	zassert_equal(uart_emul_put_rx_data(uart_dev, out, len), len);
}

static void esp_hears(const struct device *d, size_t size, void *user_data)
{
	struct tank_link_msg msg;
	uint8_t byte;

	ARG_UNUSED(size);
	ARG_UNUSED(user_data);
	while (uart_emul_get_tx_data(d, &byte, 1U) == 1U) {
		if (tank_link_decoder_push(&esp.dec, byte, &msg) != TANK_LINK_RX_FRAME) {
			continue;
		}
		int action = tank_link_receiver_on_msg(&esp.rx, &msg);

		if (action == TANK_LINK_RECV_DELIVER) {
			esp.records++;
		}
		if (action != TANK_LINK_RECV_NONE) {
			esp_reply(msg.seq);
		}
	}
}

static struct tank_app_config config(void)
{
	return (struct tank_app_config){.boot_id = boot_id,
					.log = scan_gen_log_config(RING_SECTORS),
					.scan_period_ms = PERIOD_MS,
					.clock_agreement_limit_ms = AGREEMENT_MS,
					.esp32_uart = uart_dev,
					.device_id = DEV_ID,
					.uplink = {.idle_ms = IDLE_MS, .retry_ms = RETRY_MS}};
}

static void before_each(void *fixture)
{
	ARG_UNUSED(fixture);
	scan_gen_erase();
	memset(&esp, 0, sizeof(esp));
	tank_link_decoder_init(&esp.dec);
	tank_link_receiver_init(&esp.rx);
	uart_emul_flush_rx_data(uart_dev);
	uart_emul_flush_tx_data(uart_dev);
}

static void after_each(void *fixture)
{
	ARG_UNUSED(fixture);
	(void)tank_app_stop(&app);
	uart_emul_callback_tx_data_ready_set(uart_dev, NULL, NULL);
}

ZTEST_SUITE(app_uplink, NULL, NULL, before_each, after_each, NULL);

ZTEST(app_uplink, test_scans_are_logged_while_nothing_answers)
{
	const struct tank_app_config cfg = config();

	zassert_ok(tank_app_start(&app, &cfg));
	k_msleep(RUN_MS);
	zassert_true(tank_scan_service_stats(&app.scan)->scans >= RUN_MS / PERIOD_MS,
		     "scanning waited for the link");
	zassert_equal(tank_uplink_stats(&app.up)->confirmed, 0U);
	zassert_true(tank_uplink_stats(&app.up)->sent >= 1U, "the uplink tried");
}

ZTEST(app_uplink, test_an_esp32_that_confirms_drains_the_log)
{
	const struct tank_app_config cfg = config();
	struct tank_log_item item;
	uint32_t left = 0U;

	uart_emul_callback_tx_data_ready_set(uart_dev, esp_hears, NULL);
	zassert_ok(tank_app_start(&app, &cfg));
	k_msleep(RUN_MS);
	zassert_ok(tank_app_stop(&app));

	zassert_true(esp.records >= RUN_MS / PERIOD_MS / 2U, "ESP32 got %u", esp.records);
	zassert_equal(tank_uplink_stats(&app.up)->confirmed, esp.records);
	/* Count from the delivered position, not past what was read in flight. */
	tank_flash_log_rewind(&app.log);
	while (tank_flash_log_read_next(&app.log, &item) == 0) {
		left++;
	}
	zassert_true(left <= 2U, "%u records never forwarded", left);
}

ZTEST(app_uplink, test_a_uart_needs_a_device_id)
{
	struct tank_app_config cfg = config();

	cfg.device_id = NULL;
	zassert_equal(tank_app_start(&app, &cfg), -EINVAL);
}

ZTEST(app_uplink, test_device_id_is_the_factory_id_in_hex)
{
	const uint8_t uid[] = {0x00, 0x1f, 0xa0, 0xff};
	uint8_t too_long[TANK_DEVICE_ID_UID_MAX + 1U] = {0};
	char out[TANK_DEVICE_ID_BUF_LEN];

	zassert_ok(tank_device_id_format(uid, sizeof(uid), out, sizeof(out)));
	zassert_str_equal(out, "001fa0ff");
	zassert_equal(tank_device_id_format(uid, sizeof(uid), out, 2U * sizeof(uid)), -EINVAL,
		      "no room for the NUL");
	zassert_equal(tank_device_id_format(too_long, sizeof(too_long), out, sizeof(out)), -EINVAL);
	zassert_equal(tank_device_id_format(NULL, 1U, out, sizeof(out)), -EINVAL);
	zassert_equal(tank_device_id_format(uid, 0U, out, sizeof(out)), -EINVAL);
	zassert_equal(tank_device_id_format(uid, sizeof(uid), NULL, sizeof(out)), -EINVAL);

	zassert_ok(tank_device_id_read(out, sizeof(out)));
	zassert_true(strlen(out) >= 2U && strlen(out) <= 2U * TANK_DEVICE_ID_UID_MAX);
	zassert_equal(strspn(out, "0123456789abcdef"), strlen(out), "not lowercase hex: %s", out);
}

ZTEST(app_uplink, test_a_quality_change_is_sent_at_once)
{
	struct tank_app_config cfg = config();
	const struct tank_ad4111_reading good = {.current_ma = 12.0f, .channel = 1U};
	uint32_t before;

	cfg.uplink.idle_ms = LONG_IDLE_MS;
	uart_emul_callback_tx_data_ready_set(uart_dev, esp_hears, NULL);
	zassert_ok(tank_app_start(&app, &cfg));
	k_msleep(SETTLE_MS);
	before = esp.records;

	zassert_ok(k_mutex_lock(&app.inputs_lock, K_FOREVER));
	zassert_ok(tank_loop_level_update(&app.levels[0], &good, k_uptime_get_32()));
	zassert_ok(k_mutex_unlock(&app.inputs_lock));
	k_msleep(3U * PERIOD_MS);
	zassert_true(esp.records > before, "the change waited for the long idle poll");
	zassert_true(tank_scan_service_stats(&app.scan)->changes >= 1U);
}
```
