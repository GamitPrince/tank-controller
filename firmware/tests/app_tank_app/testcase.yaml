## firmware/tests/app_tank_app/testcase.yaml
```yaml
tests:
  app.tank_app:
    tags:
      - app
    platform_allow:
      - native_sim
      - native_sim/native/64
```

## firmware/tests/communications_clock_sync/testcase.yaml
```yaml
tests:
  communications.clock_sync:
    tags:
      - communications
    platform_allow:
      - native_sim
      - native_sim/native/64
```

## firmware/tests/communications_link_delivery/testcase.yaml
```yaml
tests:
  communications.link_delivery:
    tags:
      - communications
    platform_allow:
      - native_sim
      - native_sim/native/64
```

## firmware/tests/communications_link_frame/testcase.yaml
```yaml
tests:
  communications.link_frame:
    tags:
      - communications
    platform_allow:
      - native_sim
      - native_sim/native/64
```

## firmware/tests/communications_uplink/testcase.yaml
```yaml
tests:
  communications.uplink:
    tags:
      - communications
    timeout: 600
    platform_allow:
      - native_sim
      - native_sim/native/64
```

## firmware/tests/communications_uplink_service/testcase.yaml
```yaml
tests:
  communications.uplink_service:
    tags:
      - communications
    platform_allow:
      - native_sim
      - native_sim/native/64
```

## firmware/tests/hardware_ad4111/testcase.yaml
```yaml
tests:
  hardware.ad4111:
    tags:
      - hardware
    platform_allow:
      - native_sim
      - native_sim/native/64
```

## firmware/tests/hardware_esp32_uart/testcase.yaml
```yaml
tests:
  hardware.esp32_uart:
    tags:
      - hardware
      - communications
    timeout: 600
    platform_allow:
      - native_sim
      - native_sim/native/64
```

## firmware/tests/hardware_max31865/testcase.yaml
```yaml
tests:
  hardware.max31865:
    tags:
      - hardware
    platform_allow:
      - native_sim
      - native_sim/native/64
```

## firmware/tests/measurement_loop_level/testcase.yaml
```yaml
tests:
  measurement.loop_level:
    tags:
      - measurement
    platform_allow:
      - native_sim
      - native_sim/native/64
```

## firmware/tests/measurement_pt100/testcase.yaml
```yaml
tests:
  measurement.pt100:
    tags:
      - measurement
    platform_allow:
      - native_sim
      - native_sim/native/64
```

## firmware/tests/product_temperature/testcase.yaml
```yaml
tests:
  measurement.product_temperature:
    tags:
      - measurement
    platform_allow:
      - native_sim
      - native_sim/native/64
```

## firmware/tests/record_flash_log/testcase.yaml
```yaml
tests:
  record.flash_log:
    tags:
      - record
    timeout: 600
    platform_allow:
      - native_sim
      - native_sim/native/64
```

## firmware/tests/record_scan_builder/testcase.yaml
```yaml
tests:
  record.scan_builder:
    tags:
      - record
    platform_allow:
      - native_sim
      - native_sim/native/64
```

## firmware/tests/record_scan_codec/testcase.yaml
```yaml
tests:
  record.scan_codec:
    tags:
      - record
    platform_allow:
      - native_sim
      - native_sim/native/64
```

## firmware/tests/record_scan_service/testcase.yaml
```yaml
tests:
  record.scan_service:
    tags:
      - record
    platform_allow:
      - native_sim
      - native_sim/native/64
```

## firmware/tests/safety/testcase.yaml
```yaml
tests:
  safety.level_switch:
    tags:
      - safety
    platform_allow:
      - native_sim
      - native_sim/native/64
```

## firmware/tests/safety_alarm/testcase.yaml
```yaml
tests:
  safety.alarm_input:
    tags:
      - safety
    platform_allow:
      - native_sim
      - native_sim/native/64
```
