## CMakeLists.txt
```
# The Tank-AI FRDM-MCXN947 firmware application (S-060). Until the EE's board
# overlay and pin mapping exist it is built for native_sim only, in CI.
cmake_minimum_required(VERSION 3.20.0)

find_package(Zephyr REQUIRED HINTS $ENV{ZEPHYR_BASE})
project(tank_firmware)

set(FIRMWARE_DIR ${CMAKE_CURRENT_SOURCE_DIR}/..)
include(${FIRMWARE_DIR}/cmake/tank_app_sources.cmake)

target_sources(app PRIVATE src/main.c)
tank_add_app_sources(app ${CMAKE_CURRENT_BINARY_DIR}/generated)
```

## sample.yaml
```
sample:
  name: Tank-AI firmware application
  description: >-
    The FRDM-MCXN947 application (S-060). Built for native_sim, build only,
    until the board overlay and pin mapping exist.
common:
  build_only: true
  platform_allow:
    - native_sim
    - native_sim/native/64
tests:
  app.tank_firmware:
    tags:
      - app
```

## prj.conf
```kconfig
# The flash log (S-039) runs over Zephyr's flash API with CRC-16 framing.
CONFIG_FLASH=y
CONFIG_CRC=y
# The boot id is fresh random bytes each boot (S-038).
CONFIG_ENTROPY_GENERATOR=y
# The device ID is the MCU's factory unique ID (S-061).
CONFIG_HWINFO=y
# The FRDM-to-ESP32 link (S-048) is interrupt driven.
CONFIG_SERIAL=y
CONFIG_UART_INTERRUPT_DRIVEN=y
```

## boards/native_sim.conf
```kconfig
# The emulated ESP32 UART in native_sim.overlay needs the emulator subsystem.
CONFIG_EMUL=y
```

## boards/native_sim_native_64.conf
```kconfig
# Zephyr looks up board files by the full board target; same as native_sim.conf.
CONFIG_EMUL=y
```

## boards/native_sim.overlay
```dts
/*
 * On native_sim the flash log uses the simulated flash's storage partition and
 * the ESP32 link an emulated UART that nothing answers, so records stay
 * logged. The FRDM-MCXN947 overlay (with the EE's pin mapping) points
 * tank,log-partition at the external W25Q64 and tank,esp32-uart at the real
 * UART instead.
 */
/ {
	chosen {
		tank,log-partition = &storage_partition;
		tank,esp32-uart = &esp32_uart;
	};

	esp32_uart: esp32-uart {
		compatible = "zephyr,uart-emul";
		status = "okay";
		current-speed = <115200>;
		rx-fifo-size = <1024>;
		tx-fifo-size = <2048>;
	};
};
```

## boards/native_sim_native_64.overlay
```dts
/*
 * Zephyr looks up a board overlay by the full board target, so the 64-bit
 * variant CI builds (native_sim/native/64) needs its own file; it carries the
 * same settings.
 */
#include "native_sim.overlay"
```

## src/main.c
```c
/*
 * Tank-AI FRDM-MCXN947 firmware entry point (S-060, S-061).
 *
 * Starts acquisition and logging after hardware initialisation, with or
 * without a network (decided 26 Nov 2026), then forwards the log to the ESP32
 * over the devicetree's chosen tank,esp32-uart; see tank_app.h. The flash
 * log's partition is the chosen tank,log-partition. Without a device ID the
 * records are still logged, just not forwarded.
 */

#include <zephyr/kernel.h>
#include <zephyr/random/random.h>
#include <zephyr/storage/flash_map.h>

#include "device_id.h"
#include "tank_app.h"

#define LOG_PARTITION DT_CHOSEN(tank_log_partition)

/* The ESP32 UART, or NULL on a board whose devicetree names none. */
#define ESP32_UART                                                                                 \
	COND_CODE_1(DT_HAS_CHOSEN(tank_esp32_uart), (DEVICE_DT_GET(DT_CHOSEN(tank_esp32_uart))),   \
		    (NULL))

/* One consolidated record per second (decided 26 Nov 2026). */
#define SCAN_PERIOD_MS 1000U
/* Two clock syncs further apart than this raise the warning (P1-15). */
#define CLOCK_AGREEMENT_LIMIT_MS 1000U
/* Erase sector of the W25Q64 and of native_sim's simulated flash. */
#define LOG_SECTOR_SIZE 4096U
/* S-039: a full scan every 60, the delivered position persisted every 60 acks. */
#define LOG_FULL_INTERVAL 60U
#define LOG_ACK_PERSIST_INTERVAL 60U
/*
 * Poll every 5 s when caught up, so a frame holds five one-second records
 * (decided 26 Nov 2026, S-063); every 5 s while the link is down (S-049).
 */
#define UPLINK_IDLE_MS 5000U
#define UPLINK_RETRY_MS 5000U

static struct tank_app app;
static char device_id[TANK_DEVICE_ID_BUF_LEN];

int main(void)
{
	uint8_t boot_id[TANK_BOOT_ID_LEN];
	const bool have_id = (tank_device_id_read(device_id, sizeof(device_id)) == 0);
	const struct tank_app_config cfg = {
	    .boot_id = boot_id,
	    .log =
		{
		    .flash = PARTITION_NODE_DEVICE(LOG_PARTITION),
		    .offset = PARTITION_NODE_OFFSET(LOG_PARTITION),
		    .size = PARTITION_NODE_SIZE(LOG_PARTITION),
		    .sector_size = LOG_SECTOR_SIZE,
		    .full_interval = LOG_FULL_INTERVAL,
		    .ack_persist_interval = LOG_ACK_PERSIST_INTERVAL,
		},
	    .scan_period_ms = SCAN_PERIOD_MS,
	    .clock_agreement_limit_ms = CLOCK_AGREEMENT_LIMIT_MS,
	    .esp32_uart = have_id ? ESP32_UART : NULL,
	    .device_id = have_id ? device_id : NULL,
	    .uplink = {.idle_ms = UPLINK_IDLE_MS,
		       .retry_ms = UPLINK_RETRY_MS,
		       .full_batch = TANK_UPLINK_BATCH_MAX},
	};

	sys_rand_get(boot_id, sizeof(boot_id));
	return tank_app_start(&app, &cfg);
}
```
